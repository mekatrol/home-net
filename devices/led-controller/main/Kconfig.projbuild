## devices/led-controller/main/Kconfig.projbuild
```kconfig
menu "LED controller"

    choice LED_CONTROLLER_BOARD
        prompt "Controller board"
        default LED_CONTROLLER_BOARD_ESP32_S3_ZERO if IDF_TARGET_ESP32S3
        default LED_CONTROLLER_BOARD_ESP32_C6_ZERO if IDF_TARGET_ESP32C6

        config LED_CONTROLLER_BOARD_ESP32_S3_ZERO
            bool "Waveshare ESP32-S3-Zero (WS-25081)"
            depends on IDF_TARGET_ESP32S3

        config LED_CONTROLLER_BOARD_ESP32_C6_ZERO
            bool "Waveshare ESP32-C6-Zero (WS-27035)"
            depends on IDF_TARGET_ESP32C6
    endchoice

    config LED_CONTROLLER_WIFI_SSID
        string "Wi-Fi SSID"
        default ""
        help
            Configure this with menuconfig. sdkconfig is ignored, so the real
            network name is not committed to source control.

    config LED_CONTROLLER_WIFI_PASSWORD
        string "Wi-Fi password"
        default ""
        help
            Configure this with menuconfig. sdkconfig is ignored, so the real
            network password is not committed to source control.

    config LED_CONTROLLER_STRING_1_GPIO
        int "String 1 GPIO"
        default 3 if LED_CONTROLLER_BOARD_ESP32_S3_ZERO
        default 2 if LED_CONTROLLER_BOARD_ESP32_C6_ZERO
        range 0 46
    config LED_CONTROLLER_STRING_2_GPIO
        int "String 2 GPIO"
        default 4 if LED_CONTROLLER_BOARD_ESP32_S3_ZERO
        default 3 if LED_CONTROLLER_BOARD_ESP32_C6_ZERO
        range 0 46
    config LED_CONTROLLER_STRING_3_GPIO
        int "String 3 GPIO"
        default 5 if LED_CONTROLLER_BOARD_ESP32_S3_ZERO
        default 4 if LED_CONTROLLER_BOARD_ESP32_C6_ZERO
        range 0 46
    config LED_CONTROLLER_STRING_4_GPIO
        int "String 4 GPIO"
        default 6 if LED_CONTROLLER_BOARD_ESP32_S3_ZERO
        default 5 if LED_CONTROLLER_BOARD_ESP32_C6_ZERO
        range 0 46

endmenu
```

## devices/led-controller/sdkconfig.defaults
```kconfig
CONFIG_IDF_TARGET="esp32s3"
CONFIG_ESPTOOLPY_FLASHSIZE_4MB=y
CONFIG_SPIRAM=y
CONFIG_SPIRAM_MODE_QUAD=y
CONFIG_FREERTOS_HZ=1000
CONFIG_ESP_CONSOLE_USB_SERIAL_JTAG=y
CONFIG_ESP_CONSOLE_SECONDARY_NONE=y
```

## devices/mqtt-switch-c/main/Kconfig.projbuild
```kconfig
menu "MQTT switch"

    config MQTT_SWITCH_WIFI_SSID
        string "Wi-Fi SSID"
        default ""
        help
            Set this in menuconfig. The generated sdkconfig file is ignored so
            the real Wi-Fi network name is not committed.

    config MQTT_SWITCH_WIFI_PASSWORD
        string "Wi-Fi password"
        default ""
        help
            Set this in menuconfig. The generated sdkconfig file is ignored so
            the real Wi-Fi password is not committed.

    config MQTT_SWITCH_BROKER_URI
        string "MQTT broker URI"
        default ""
        help
            Set this in menuconfig. Use a full ESP-IDF MQTT URI. The generated
            sdkconfig file is ignored so the real broker address is not
            committed.

    config MQTT_SWITCH_CLIENT_ID
        string "MQTT client ID"
        default "mqtt-switch"

    config MQTT_SWITCH_USERNAME
        string "MQTT username"
        default ""
        help
            Set this in menuconfig. Leave empty if the broker does not require
            a username.

    config MQTT_SWITCH_PASSWORD
        string "MQTT password"
        default ""
        help
            Set this in menuconfig. Leave empty if the broker does not require
            a password.

    config MQTT_SWITCH_SET_TOPIC
        string "MQTT set topic"
        default ""
        help
            Set this in menuconfig. The generated sdkconfig file is ignored so
            real deployment topic names are not committed.

    config MQTT_SWITCH_STATUS_TOPIC
        string "MQTT status topic"
        default ""
        help
            Set this in menuconfig. The generated sdkconfig file is ignored so
            real deployment topic names are not committed.

    config MQTT_SWITCH_OUTPUT_GPIO
        int "Output GPIO"
        default 5
        range 0 46

    config MQTT_SWITCH_STATUS_LED_GPIO
        int "Status LED GPIO"
        default 15
        range 0 46
        help
            Wemos ESP32-S2 Mini boards expose the onboard single-color status
            LED on GPIO15.

    config MQTT_SWITCH_STATUS_LED_ACTIVE_LEVEL
        int "Status LED active GPIO level"
        default 0
        range 0 1
        help
            GPIO level that turns the status LED on. Use 0 for active-low LEDs
            that turn on when the GPIO sinks current, or 1 for active-high LEDs.

    config MQTT_SWITCH_MQTT_INACTIVITY_TIMEOUT_SECONDS
        int "MQTT inactivity reset timeout seconds"
        default 3600
        range 1 86400

    config MQTT_SWITCH_MQTT_INACTIVITY_WARNING_SECONDS
        int "MQTT inactivity warning seconds"
        default 20
        range 1 86400

endmenu
```

## devices/mqtt-switch-c/sdkconfig.defaults
```kconfig
CONFIG_IDF_TARGET="esp32s2"
CONFIG_ESPTOOLPY_FLASHSIZE_4MB=y
CONFIG_FREERTOS_HZ=1000
CONFIG_MQTT_PROTOCOL_311=y
CONFIG_ESP_CONSOLE_USB_CDC=y
CONFIG_ESP_CONSOLE_SECONDARY_NONE=y
```
